## components/frame_store/Kconfig
```kconfig
menu "PhotoPainter firmware frame cache"

config PHOTOPAINTER_ENABLE_CACHE
    bool "Enable the optional PhotoPainter frame cache partition"
    default n
    help
        Enable A/B frame storage only when the partition table contains a
        verified `photocache` data partition. The default is disabled because
        the shipped 2 MiB partition table has no cache partition.

config PHOTOPAINTER_CACHE_PARTITION
    string "Frame cache partition label"
    default "photocache"
    depends on PHOTOPAINTER_ENABLE_CACHE

config PHOTOPAINTER_CACHE_SLOT_SIZE
    int "Frame cache slot size"
    default 262144
    range 196608 1048576
    depends on PHOTOPAINTER_ENABLE_CACHE
    help
        Each A/B slot must fit the 192000-byte packed frame and its metadata.
        Keep this value aligned to the flash erase sector size.

endmenu
```

## components/ha_frame_client/Kconfig
```kconfig
menu "PhotoPainter Home Assistant client"

config PHOTOPAINTER_HA_ALLOW_INSECURE_HTTP
    bool "Allow plain HTTP for the Home Assistant origin"
    default n
    help
        Plain HTTP is disabled by default. Enable this only for an isolated,
        explicitly trusted network; HTTPS with the ESP certificate bundle is
        required for normal operation.

config PHOTOPAINTER_HA_ORIGIN
    string "Home Assistant origin"
    default "https://homeassistant.local"
    help
        Scheme and host only, for example https://ha.example.test. Paths,
        query strings, and redirects are not accepted by the client.

config PHOTOPAINTER_HA_DEVICE_ID
    string "Home Assistant PhotoPainter device ID"
    default "hall-display"

config PHOTOPAINTER_HA_TIMEOUT_MS
    int "Home Assistant request timeout (ms)"
    default 10000
    range 1000 30000

endmenu
```

## components/task_service/Kconfig.projbuild
```kconfig
menu "Task Service Configuration"

    config TODOIST_API_TOKEN
        string "Todoist API Token"
        default ""
        help
            API token for Todoist REST API.
            Get your token from: Settings -> Integrations -> Developer

endmenu
```

## components/train_service/Kconfig.projbuild
```kconfig
menu "Train Service Configuration"

    config TRAIN_LINE_NAME
        string "Train Line Name"
        default ""
        help
            Name of the train line to monitor for delays.
            Example: "中央線" (must match exactly with JR East page)

endmenu
```

## main/Kconfig.projbuild
```kconfig
menu "PhotoPainter Configuration"

    config WIFI_SSID
        string "WiFi SSID"
        default "myssid"
        help
            SSID (network name) to connect to.

    config WIFI_PASSWORD
        string "WiFi Password"
        default "mypassword"
        help
            WiFi password (WPA or WPA2) to use.

    config TIMEZONE
        string "Timezone"
        default "JST-9"
        help
            POSIX timezone string (e.g., JST-9 for Japan).

    config DISABLE_DEEP_SLEEP
        bool "Disable deep sleep (debug)"
        default n
        help
            Keep running without entering deep sleep.

endmenu
```

## sdkconfig.defaults
```kconfig
# ESP32-S3 PhotoPainter Board Configuration
# Target: ESP32-S3

# PSRAM Configuration (Octal mode for PhotoPainter board)
CONFIG_SPIRAM=y
CONFIG_SPIRAM_MODE_OCT=y
CONFIG_SPIRAM_SPEED_80M=y
CONFIG_SPIRAM_BOOT_INIT=y
CONFIG_SPIRAM_USE_MALLOC=y
CONFIG_SPIRAM_MEMTEST=y
CONFIG_SPIRAM_MALLOC_ALWAYSINTERNAL=16384
CONFIG_SPIRAM_MALLOC_RESERVE_INTERNAL=32768
CONFIG_SPIRAM_ALLOW_STACK_EXTERNAL_MEMORY=y

# Main task stack size (larger for complex operations)
CONFIG_ESP_MAIN_TASK_STACK_SIZE=8192

# Flash Size (physical flash on the target board is 16 MB)
CONFIG_ESPTOOLPY_FLASHSIZE_16MB=y
CONFIG_ESPTOOLPY_FLASHSIZE="16MB"

# Partition table
CONFIG_PARTITION_TABLE_CUSTOM=y
CONFIG_PARTITION_TABLE_CUSTOM_FILENAME="partitions.csv"

# WiFi Configuration
CONFIG_ESP_WIFI_STATIC_RX_BUFFER_NUM=10
CONFIG_ESP_WIFI_DYNAMIC_RX_BUFFER_NUM=32
CONFIG_ESP_WIFI_DYNAMIC_TX_BUFFER_NUM=32
CONFIG_ESP_WIFI_AMPDU_TX_ENABLED=y
CONFIG_ESP_WIFI_AMPDU_RX_ENABLED=y

# HTTPS/TLS Support
CONFIG_ESP_TLS_USING_MBEDTLS=y
CONFIG_MBEDTLS_SSL_MAX_CONTENT_LEN=16384
CONFIG_MBEDTLS_CERTIFICATE_BUNDLE=y
CONFIG_MBEDTLS_CERTIFICATE_BUNDLE_DEFAULT_FULL=y

# SNTP
CONFIG_LWIP_SNTP_MAX_SERVERS=2

# NVS
CONFIG_NVS_ENCRYPTION=n

# Log Level
CONFIG_LOG_DEFAULT_LEVEL_INFO=y
CONFIG_LOG_MAXIMUM_LEVEL_DEBUG=y

# FreeRTOS
CONFIG_FREERTOS_HZ=1000

# Power Management
CONFIG_PM_ENABLE=y
CONFIG_PM_POWER_DOWN_CPU_IN_LIGHT_SLEEP=y

# Deep Sleep
CONFIG_ESP_SLEEP_GPIO_RESET_WORKAROUND=y

# ============================================================
# Weather Calendar Configuration
# ============================================================
# Secret values - set via menuconfig or environment:
#   CONFIG_WIFI_SSID
#   CONFIG_WIFI_PASSWORD
#   CONFIG_OPENWEATHERMAP_API_KEY
#   CONFIG_TODOIST_API_TOKEN

# Location (Tokyo default)
CONFIG_LOCATION_LATITUDE="35.6762"
CONFIG_LOCATION_LONGITUDE="139.6503"
CONFIG_TIMEZONE="JST-9"

# Update intervals
CONFIG_DISABLE_DEEP_SLEEP=y
CONFIG_UPDATE_INTERVAL_DAY_MIN=30
CONFIG_UPDATE_INTERVAL_NIGHT_MIN=120
CONFIG_API_CALL_INTERVAL_HOURS=3
```
